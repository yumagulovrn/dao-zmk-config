## config/boards/arm/dao/Kconfig.defconfig
```kconfig
# Copyright (c) 2021 Rafael Yumagulov
# SPDX-License-Identifier: MIT

if BOARD_DAO_LEFT

	config ZMK_KEYBOARD_NAME
	default "Wisatento"

    config ZMK_SPLIT_BLE_ROLE_CENTRAL
	default y

endif # BOARD_Wisatento_LEFT

if BOARD_Wisatento_RIGHT

	config ZMK_KEYBOARD_NAME
	default "Wisatento Right"

endif # BOARD_Wisatento_RIGHT


if BOARD_Wisatento_LEFT || BOARD_Wisatento_RIGHT

config BOARD
	default "Wisatento"

config ZMK_SPLIT
	default y

config BT_CTLR
	default BT

config ZMK_BLE
	default y

config ZMK_USB
	default y

config ZMK_BATTERY_VOLTAGE_DIVIDER
	default y

if USB

config USB_NRFX
	default y

config USB_DEVICE_STACK
	default y

endif # USB

endif # BOARD_Wisatento_LEFT || BOARD_Wisatento_RIGHT
```

## config/west.yml
```yaml
manifest:
  remotes:
    - name: zmkfirmware
      url-base: https://github.com/zmkfirmware
    - name: ergonautkb
      url-base: https://github.com/ergonautkb
  projects:
    - name: zmk
      remote: zmkfirmware
      revision: main
      import: app/west.yml
    - name: ergonautkb-zmk-module
      remote: ergonautkb
      revision: main
  self:
    path: config
```
